## Kconfig
```kconfig
menuconfig GAMMA
    bool "Gamma kernel configuration"
    default y

source "kernel/Kconfig"
source "arch/Kconfig"
source "block/Kconfig"
source "crypto/Kconfig"
source "drivers/Kconfig"
source "fs/Kconfig"
source "init/Kconfig"
source "ipc/Kconfig"
source "lib/Kconfig"
source "mm/Kconfig"
source "net/Kconfig"
source "tools/Kconfig"
```

## arch/Kconfig
```kconfig
menuconfig GAMMA_ARCH
    bool "Architecture support"
    default y

source "arch/x86/Kconfig"
```

## arch/x86/Kconfig
```kconfig
config ARCH_X86
    bool "x86 architecture support"
    default y
    help
      Enable x86-specific boot and startup code.
```

## block/Kconfig
```kconfig
menuconfig BLOCK
    bool "Block device subsystem"
    default y
    help
      Enable block device support for storage.
```

## crypto/Kconfig
```kconfig
menuconfig CRYPTO
    bool "Cryptographic support"
    default y
    help
      Enable cryptographic primitives and security helpers.
```

## drivers/Kconfig
```kconfig
menuconfig DRIVERS
    bool "Kernel drivers"
    default y
    help
      Enable kernel driver support infrastructure.
```

## fs/Kconfig
```kconfig
menuconfig FS
    bool "Filesystem support"
    default y
    help
      Enable filesystem and VFS support for the Gamma kernel.
```

## init/Kconfig
```kconfig
menuconfig INIT
    bool "Init support"
    default y
    help
      Enable early init and init process support.
```

## ipc/Kconfig
```kconfig
menuconfig IPC
    bool "IPC support"
    default y
    help
      Enable inter-process communication primitives.
```

## kernel/Kconfig
```kconfig
config GAMMA_KERNEL
    bool "Gamma kernel"
    default y
    help
      Enable the core Gamma kernel.
```

## lib/Kconfig
```kconfig
menuconfig LIB
    bool "Kernel library helpers"
    default y
    help
      Enable reusable kernel library support.
```

## mm/Kconfig
```kconfig
menuconfig MM
    bool "Memory management"
    default y
    help
      Enable memory management subsystem for Gamma.
```

## net/Kconfig
```kconfig
menuconfig NET
    bool "Networking"
    default y
    help
      Enable networking subsystem support.
```

## tools/Kconfig
```kconfig
menuconfig TOOLS
    bool "Kernel tools"
    default y
    help
      Enable userland tools and utilities for kernel development.
```
